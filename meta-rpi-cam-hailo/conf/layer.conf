## meta-rpi-cam-hailo/conf/layer.conf
```bitbake
BBPATH .= ":${LAYERDIR}"
RPI_CAM_HAILO_LAYERDIR := "${LAYERDIR}"
BBFILES += "${LAYERDIR}/recipes-*/*/*.bb ${LAYERDIR}/recipes-*/*/*.bbappend"

BBFILE_COLLECTIONS += "rpicamhailo"
BBFILE_PATTERN_rpicamhailo = "^${LAYERDIR}/"
BBFILE_PRIORITY_rpicamhailo = "9"

LAYERDEPENDS_rpicamhailo = "core rpi5cam openembedded-layer multimedia-layer"
LAYERSERIES_COMPAT_rpicamhailo = "wrynose"
```

## meta-rpi5-cam/conf/layer.conf
```bitbake
BBPATH .= ":${LAYERDIR}"
RPI5_CAM_LAYERDIR := "${LAYERDIR}"
BBFILES += "${LAYERDIR}/recipes-*/*/*.bb ${LAYERDIR}/recipes-*/*/*.bbappend"

# The Raspberry Pi BSP exposes libcamera-apps only with meta-multimedia.
BBFILES_DYNAMIC += "multimedia-layer:${LAYERDIR}/dynamic-layers/multimedia-layer/recipes-*/*/*.bbappend"

addpylib ${LAYERDIR}/lib rpi5cam

BBFILE_COLLECTIONS += "rpi5cam"
BBFILE_PATTERN_rpi5cam = "^${LAYERDIR}/"
BBFILE_PRIORITY_rpi5cam = "8"

LAYERDEPENDS_rpi5cam = "core"
LAYERSERIES_COMPAT_rpi5cam = "wrynose"
```
